 #include "include.h"

//////////////////////////////////////////////////////////////////////////////////
//// 功能描述 : 定时器0初始化
//// 输入参数 : 
//// 返回参数 : 
//// 说明     :  
//////////////////////////////////////////////////////////////////////////////////
void Timer0_Init (void)			 // 30us
{
	TR0 = 1;          //Timer0启动,即TCON=0x10;
	ET0 = 1;          //T0溢出中断允许
 	TH0 = (255-10);		//10US 
 	TMOD = 2;			    //定时器0 8bit自动重装载
 	CKCON |= 0x01;		//4分频率  6/4
	EA =0;
}
//////////////////////////////////////////////////////////////////////////////////
//// 功能描述 : 定时器0中断入口函数
//// 输入参数 : 
//// 返回参数 : 
//// 说明     :  1ms采集一次 连续采样20此大于基准电压，表示有触发
//////////////////////////////////////////////////////////////////////////////////
void Timer0(void) interrupt 1 				//10us
{
	count++;					                  //对10us计数				

  if(LedDelayCnt>0)                   //按键关断计时
		 LedDelayCnt--;
	
	if(count>FSLEDONTIME)                 //持续发射
	{	
			if(basecount<BASE_AD_COUNT)
				 basecount++;
			count=0;
			pEMILEDCTL = ON;			            // 发射管打开
			
//			count++;
//			count--;
		

		  sampDat = ADC_Samp(); 	          // 采集高端数据	
		  f_prossout = TRUE;                //发射一次完成
		
/*******以下是基准采样******************************************/		
		  if(basecount <= BASE_AD_COUNT)
			{
				if((basecount%10) == 0) 	      // 基准值 采样10次
				{ 
					RevBase+=sampDat;
				}
		  }
			if(basecount==BASE_AD_COUNT)      //取平均值
			{
				basecount=BASE_AD_COUNT+10;
			  RevBase = RevBase/(BASE_AD_COUNT/10);
				AD_Base=OK;
			}
/*****************************************************************/		
		
		
		
///****每次空闲的时候都进行基准采样确保在设备移动过程中基准发生变化***********************/		
//			if((basecount>First_Base)&&(out<StardBase))                     //第一次判断是否空闲  
//				AD_BaseOne=OK;
//			else
//				AD_BaseOne=NO_OK;
//			
//			if((basecount>Second_Base)&&(out<StardBase)&&(AD_BaseOne=OK)) 	//第二次确定是否空闲 依然空闲，确定可以作为基准  开始 保存基准
//			{
//		    basecount=0;
//				RevBase=sampDat;
//				AD_Base=OK;
//			}
//			if((basecount>Second_Base)&&(out>StardBase))                    //当第二次 不再空闲，那么清零第一次的空闲标志        
//				AD_BaseOne=NO_OK;
///***************************************************************************************/
			 
	}
	else
	{
		 pEMILEDCTL = OFF;			          // 发射管关闭
	}
	}

//////////////////////////////////////////////////////////////////////////////////
//// 功能描述 : 定时器0开启
//// 输入参数 : 
//// 返回参数 : 
//// 说明     :  
//////////////////////////////////////////////////////////////////////////////////
void Interrupt_Init (void)
{
	EA = 1; //中断允许总控制位
}